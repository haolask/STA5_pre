## sources/linux/drivers/pinctrl/nomadik/Kconfig
```kconfig
if ARCH_U8500

config PINCTRL_ABX500
	bool "ST-Ericsson ABx500 family Mixed Signal Circuit gpio functions"
	depends on AB8500_CORE
	select GENERIC_PINCONF
	help
	  Select this to enable the ABx500 family IC GPIO driver

config PINCTRL_AB8500
	bool "AB8500 pin controller driver"
	depends on PINCTRL_ABX500 && ARCH_U8500

config PINCTRL_AB8540
	bool "AB8540 pin controller driver"
	depends on PINCTRL_ABX500 && ARCH_U8500

config PINCTRL_AB9540
	bool "AB9540 pin controller driver"
	depends on PINCTRL_ABX500 && ARCH_U8500

config PINCTRL_AB8505
	bool "AB8505 pin controller driver"
	depends on PINCTRL_ABX500 && ARCH_U8500

endif

if (ARCH_U8500 || ARCH_NOMADIK || ARCH_STA)

config PINCTRL_NOMADIK
	bool "Nomadik pin controller driver"
	depends on ARCH_U8500 || ARCH_NOMADIK || ARCH_STA
	depends on OF && GPIOLIB
	select PINMUX
	select PINCONF
	select OF_GPIO
	select GPIOLIB_IRQCHIP

config PINCTRL_STN8815
	bool "STN8815 pin controller driver"
	depends on PINCTRL_NOMADIK && ARCH_NOMADIK

config PINCTRL_DB8500
	bool "DB8500 pin controller driver"
	depends on PINCTRL_NOMADIK && ARCH_U8500

config PINCTRL_DB8540
	bool "DB8540 pin controller driver"
	depends on PINCTRL_NOMADIK && ARCH_U8500

config PINCTRL_STA1295
	bool "STA1295 pin controller driver"
	depends on PINCTRL_NOMADIK && ARCH_STA

config PINCTRL_STA1385
	bool "STA1385 pin controller driver"
	depends on PINCTRL_NOMADIK && ARCH_STA

endif
```

## sources/linux/drivers/rpmsg/Kconfig
```kconfig
menu "Rpmsg drivers"

# RPMSG always gets selected by whoever wants it
config RPMSG
	tristate

config RPMSG_CHAR
	tristate "RPMSG device interface"
	depends on RPMSG
	help
	  Say Y here to export rpmsg endpoints as device files, usually found
	  in /dev. They make it possible for user-space programs to send and
	  receive rpmsg packets.

config RPMSG_QCOM_SMD
	tristate "Qualcomm Shared Memory Driver (SMD)"
	depends on QCOM_SMEM
	depends on QCOM_SMD=n
	select RPMSG
	help
	  Say y here to enable support for the Qualcomm Shared Memory Driver
	  providing communication channels to remote processors in Qualcomm
	  platforms.

config RPMSG_VIRTIO
	tristate
	select RPMSG
	select VIRTIO
	select VIRTUALIZATION

if RPMSG
config STA_RPMSG
	tristate "ST rpmsg support for STA SoC family"
	depends on STA_REMOTEPROC
	depends on ARCH_STA
	help
	  Say y or m here to support ST rpmsg messaging bus
	  to communicate with remote processor available on
	  STA SoCs (e.g. M3 on STA12xx).

config STA_RPMSG_RDM
	tristate "Remote device sharing through RPMSG"
	depends on REMOTEPROC_SRM_STA_DEV
	help
	  Say y to activate the support of dynamic enabling/disabling of devices
	  from remote processors requests.

endif
endmenu
```

## sources/linux/sound/soc/sta/Kconfig
```kconfig
#
# STA SoC audio configuration
#
config SND_SOC_STA
	tristate "SoC Audio support for STA platform"
	depends on SND_SOC
	depends on ARCH_STA
        select SND_SOC_GENERIC_DMAENGINE_PCM
	help
		Say Y if you want to enable the ASoC support for the STA platforms.
		The STA Sound Subsystem includes:
		 audio ports (MSP, DPMAILBOX)
		 Emerald DSPs
		 The Audio Interface (AIF) with HW sample rate converter and a dedicated BUS for audio
		By default it enables also MSP, AIF, DPMAILBOX and STAUDIOLIB

config SND_SOC_STA_MSP
	tristate
	default SND_SOC_STA

config SND_SOC_STA_AIF
	tristate
	default SND_SOC_STA

config SND_SOC_STA_DPMAILBOX
	tristate "Enable DP-Mailbox"
	depends on SND_SOC_STA
	default SND_SOC_STA
	help
		DP-Mailbox is the module that allows the transfer of samples between the
		asynchronous Bus Matrix and the isochronous Sound Subsystem.
		It is composed by FIFO1 and FIFO2.
		Enable FIFO1 to transfer data from the Sound Subsystem to the Bus Matrix
		and FIFO2 to transfer data from the Bus Matrix to the Sound Subsystem.

config SND_SOC_STA_NO_RESIDUE
	bool "PCM avail reported without DMA residue"
	depends on SND_SOC_STA
	default n
	help
	  STA PCM support report of PCM avail both with or without DMA residue
	  Say N if you want reported accurate PCM avail
	  Say Y if you want reported best performance PCM avail (deprecated)

config SND_SOC_STA_STAUDIOLIB
	tristate "DSP - STA"
	default SND_SOC_STA
	help
		Enable the ST Audio library for DSPs.
		The STaudiolib initializes the DSPs
		and exposes a set of API to compose a network
		with different modules inside the DSP.

config STAUDIOLIB_EMBEDDED_FW
	bool "Embeds DSP FW"
	depends on SND_SOC_STA_STAUDIOLIB
	help
	  staudiolib requires a firmware loaded into STA DSP
	  Say N if the FW is loaded by the bootloader,
	  Say N if you want load DSP FW from /lib/firmware
	  Say Y if you want the DSP FW embedded in staudiolib

config SND_SOC_EXT_DSP
	tristate "DSP - EXT"
	default m
	help
		Enable the loading of non-ST DSP firmware.
		The FW file must be present in /lib/firmware/st/dspfw
		and the driver must be compiled as module.
		The driver can be customized adding ALSA control
		to configure the FW.
```

## sources/u-boot/arch/arm/cpu/armv7/sta/Kconfig
```kconfig
if ARCH_STA

config STA
	bool
	default y

choice
	prompt "ST-Microelectronics STA SoC select"
	default SOC_STA1295

config SOC_STA1295
	bool "STA1295 SoC"

config SOC_STA1195
	bool "STA1195 SoC"

config SOC_STA1385
	bool "STA1385 SoC"

config SOC_STA1275
	bool "STA1275 SoC"

endchoice

choice
	prompt "STA board select"
	optional

config TARGET_STA_EVB
	select CPU_V7_HAS_NONSEC
	bool "STA EVB (Accordo5/Telemaco3) board family"

endchoice

config SYS_TEXT_BASE
	default 0x00000000 if ARMV7_NONSEC
	default 0xA0000000 if !ARMV7_NONSEC

config STA_STR
	bool "STA STR feature"

config STA_STR_TAG
	hex "TAG to indicate STR state"
	depends on STA_STR
	default  0x53545200

source "board/st/sta-evb/Kconfig"

endif
```

## sources/u-boot/board/st/sta-evb/Kconfig
```kconfig
if TARGET_STA_EVB

config SYS_VENDOR
	default "st"

config SYS_SOC
	default "sta"

config SYS_BOARD
	default "sta-evb"

config SYS_CONFIG_NAME
	default "sta-common"

endif

config STA_GPIO
	default y
```

## sources/u-boot/configs/sta-nand-flashloader_defconfig
```kconfig
CONFIG_ARM=y
CONFIG_ARCH_STA=y
CONFIG_SYS_MALLOC_F_LEN=0x2000
CONFIG_TARGET_STA_EVB=y
CONFIG_STA_STR=y
# CONFIG_ARMV7_NONSEC is not set
CONFIG_OF_BOARD_SETUP=y
CONFIG_NAND_BOOT=y
CONFIG_BOOTDELAY=0
CONFIG_CONSOLE_RECORD_OUT_SIZE=0x1000
CONFIG_SILENT_CONSOLE=y
# CONFIG_DISPLAY_CPUINFO is not set
CONFIG_HUSH_PARSER=y
CONFIG_SYS_PROMPT="A5> "
CONFIG_AUTOBOOT_KEYED=y
CONFIG_AUTOBOOT_PROMPT="Hit SPACE to stop autoboot: %d\n"
CONFIG_AUTOBOOT_STOP_STR=" "
CONFIG_FASTBOOT=y
CONFIG_USB_FUNCTION_FASTBOOT=y
CONFIG_CMD_FASTBOOT=y
CONFIG_FASTBOOT_BUF_ADDR=0x0
CONFIG_FASTBOOT_BUF_SIZE=0x0
# CONFIG_CMD_BOOTD is not set
# CONFIG_CMD_ELF is not set
# CONFIG_CMD_GO is not set
# CONFIG_CMD_IMLS is not set
# CONFIG_CMD_XIMG is not set
# CONFIG_CMD_EXPORTENV is not set
# CONFIG_CMD_IMPORTENV is not set
# CONFIG_CMD_LOADS is not set
# CONFIG_CMD_FLASH is not set
CONFIG_CMD_NAND=y
# CONFIG_CMD_FPGA is not set
# CONFIG_CMD_ITEST is not set
# CONFIG_CMD_SETEXPR is not set
CONFIG_CMD_DHCP=y
# CONFIG_CMD_NFS is not set
CONFIG_CMD_PING=y
# CONFIG_CMD_MISC is not set
CONFIG_CMD_FS_GENERIC=y
CONFIG_CMD_UBI=y
# CONFIG_PARTITIONS is not set
CONFIG_OF_CONTROL=y
# CONFIG_DM_WARN is not set
# CONFIG_DM_DEVICE_REMOVE is not set
# CONFIG_MMC is not set
CONFIG_DM_ETH=y
CONFIG_STM_GMAC4=y
CONFIG_CC_OPTIMIZE_LIBS_FOR_SPEED=y
CONFIG_OF_LIBFDT_OVERLAY=y
# CONFIG_EFI_LOADER is not set
```

## sources/u-boot/configs/sta-sqi-flashloader_defconfig
```kconfig
CONFIG_ARM=y
CONFIG_ARCH_STA=y
CONFIG_SYS_MALLOC_F_LEN=0x2000
CONFIG_TARGET_STA_EVB=y
CONFIG_STA_STR=y
# CONFIG_ARMV7_NONSEC is not set
CONFIG_FIT=y
CONFIG_FIT_SIGNATURE=y
CONFIG_OF_BOARD_SETUP=y
CONFIG_QSPI_BOOT=y
CONFIG_BOOTDELAY=0
CONFIG_CONSOLE_RECORD_OUT_SIZE=0x1000
CONFIG_SILENT_CONSOLE=y
# CONFIG_DISPLAY_CPUINFO is not set
CONFIG_HUSH_PARSER=y
CONFIG_SYS_PROMPT="A5> "
CONFIG_AUTOBOOT_KEYED=y
CONFIG_AUTOBOOT_PROMPT="Hit SPACE to stop autoboot: %d\n"
CONFIG_AUTOBOOT_STOP_STR=" "
CONFIG_FASTBOOT=y
CONFIG_USB_FUNCTION_FASTBOOT=y
CONFIG_CMD_FASTBOOT=y
CONFIG_FASTBOOT_BUF_ADDR=0x0
CONFIG_FASTBOOT_BUF_SIZE=0x0
CONFIG_FASTBOOT_FLASH=y
CONFIG_FASTBOOT_FLASH_MMC_DEV=0
# CONFIG_CMD_GO is not set
# CONFIG_CMD_IMLS is not set
# CONFIG_CMD_XIMG is not set
# CONFIG_CMD_EXPORTENV is not set
# CONFIG_CMD_IMPORTENV is not set
# CONFIG_CMD_LOADS is not set
# CONFIG_CMD_FLASH is not set
CONFIG_CMD_SF=y
# CONFIG_CMD_FPGA is not set
# CONFIG_CMD_ITEST is not set
# CONFIG_CMD_SETEXPR is not set
CONFIG_CMD_DHCP=y
# CONFIG_CMD_NFS is not set
CONFIG_CMD_PING=y
# CONFIG_CMD_MISC is not set
CONFIG_CMD_UBI=y
CONFIG_OF_CONTROL=y
# CONFIG_DM_WARN is not set
# CONFIG_DM_DEVICE_REMOVE is not set
CONFIG_DM_SPI_FLASH=y
CONFIG_SPI_FLASH=y
CONFIG_SPI_FLASH_BAR=y
CONFIG_SPI_FLASH_MACRONIX=y
CONFIG_SPI_FLASH_SPANSION=y
CONFIG_SPI_FLASH_STMICRO=y
CONFIG_DM_ETH=y
CONFIG_STM_GMAC4=y
CONFIG_DM_SPI=y
CONFIG_STA_QSPI=y
CONFIG_STA_QSPI_SHARED=y
CONFIG_CC_OPTIMIZE_LIBS_FOR_SPEED=y
CONFIG_OF_LIBFDT_OVERLAY=y
# CONFIG_EFI_LOADER is not set
```
