## sources/linux/Documentation/devicetree/bindings/power/reset/sta1295-poweroff.txt
```
sta1295 power off and restart driver
------------------------------------

The sta1295-prm driver provides power off and restart functionalities
for STA1295 based boards.

For security reason, it does not directly program STA1295 PMU and SRC-M3
registers but sends requests through IPC/RPSMG to a back-end driver running
in the Cortex-M3 sub-system.

In addition to power off and restart features, sta1295-prm driver can
program the STA1295 PMU wake-up and goto stand-by sources.

Required properties:

 - compatible: "st,sta1295-prm"

Optional properties:

 - st,register_sby: Be notified on a software reset event from back-end.
 - st,register_sw_reset: Be notified on a goto stand-by event from back-end.
 - st,do_poweroff_on_sby: To do a system power-off on incoming goto stand-by
   request from back-end driver.

 Values for the following properties must be integer and must match
 "PMU_WKUP_SRC_MASK" mask. See sta1295-poweroff.c header for more details.

 - st,enable_wkup_src: Stand-by to On sources to enable.
 - st,disable_wkup_src: Stand-by to On sources to disable.
 - st,rising_wkup_edge: Select rising edges for wake-up sources.
 - st,falling_wkup_edge: Select falling edges for wake-up sources.

 Values for the following properties must be integer and must match
 "PMU_SBY_SRC_MASK" mask. See sta1295-poweroff.c header for more details.

 - st,enable_sby_src: On to stand-by sources to enable.
 - st,disable_sby_src: On to stand-by sources to disable.
 - st,rising_sby_edge: Select rising edges for stand-by sources.
 - st,falling_sby_edge: Select falling edges for stand-by sources.
 - st,enable_sby_irq: On to stand-by irqs to enable.
 - st,disable_sby_irq: On to stand-by irqs to disable.

Example:
		prm {
			compatible = "st,sta1295-prm";
			st,register_sby;
			st,register_sw_reset;
			/* falling edge for wakes 0, 1 */
			st,falling_wkup_edge = <48>;
			/* enable wakes 0, 1, 2, 3 */
			st,enable_wkup_src = <240>;
		};
```

## sources/linux/Documentation/devicetree/bindings/pwm/sta-eft.txt
```
STMicroelectronics Extended Function Timer

Required properties:
- compatible		: Should be "st,sta-eft"
- reg			: contain the base adresse of the different eft's
			  registers
- reg-names		: Should contains the reg name "eft_reg"

Exemples:
eft0: eft@48180000 {
	compatible = "st,sta-eft";
	reg = <0x48180000 0x1000>;
	reg-names = "eft_regs";
};
```

## sources/linux/Documentation/devicetree/bindings/remoteproc/rproc-srm.txt
```
Remoteproc System Resource Manager
----------------------------------

The remoteproc SRM (System Resource Manager) handles resources allocated
to remote processors.
This makes it possible for remote proc to reserve and initialize system
resources for a peripheral assigned to a coprocessor.

The devices are grouped in a core node

Core
====
Required properties:
- compatible: should be "rproc-srm-core"

Dev (Generic)
===
Required properties:
- compatible: should be "rproc-srm-dev"

Optional properties:
- clocks: clocks required by the coprocessor
- clock-names: see clock-bindings.txt
- assigned-clocks: see clock-bindings.txt
- assigned-clock-parents: see clock-bindings.txt
- assigned-clock-rates: see clock-bindings.txt
- pinctrl-x: pins configurations required by the coprocessor
- pinctrl-names: see pinctrl-bindings.txt
- x-supply: power supplies required by the coprocessor

Example:
	system_resources {
		compatible = "rproc-srm-core";

		mmc0: sdhci@09060000 {
			compatible = "rproc-srm-dev";
			pinctrl-names = "default", "idle";
			pinctrl-0 = <&pinctrl_mmc0>;
			pinctrl-1 = <&pinctrl_mmc1>;
			clock-names = "mmc", "icn";
			clocks = <&clk_s_c0_flexgen CLK_MMC_0>,
				 <&clk_s_c0_flexgen CLK_RX_ICN_HVA>;
			vdda-supply = <&vdda>;
		};
	};

Dev (STA)
===
Required properties:
- compatible: should be "rproc-srm-sta-dev"
- st,shared-dev: phandle to any node that can be enabled/disabled
		 through SRM STA dev

Example:
	rproc {
		compatible = "st,sta-rproc";
		st,rp-name = "rproc-CSS";
		mboxes = <&mailbox 0>;
		system_resources {
			compatible = "rproc-srm-core";
			tuner_i2c {
				status = "okay";
				compatible = "rproc-srm-sta-dev";
				st,shared-dev = <&i2c1>;
			};
		};
	};
```

## sources/linux/Documentation/devicetree/bindings/remoteproc/sta-remoteproc.txt
```
STMicroelectronics Remoteproc Driver

Required properties:
- compatible		: Should the following:
			  "st,sta-rproc" for STA SoCs
- st,rp-name		: Remote processor name
- mboxes		: Mailbox name assigned to this remoteproc
			  (cf. mailbox-sta bindings)
Optional properties:
- st,rp-fw-name		: Firmware name of the remoteproc to download
- st,rsc-carveout-name	: Array of name of the RSC_CARVEOUT requested memory
			  region
Examples:

rproc {
	compatible = "st,sta-rproc";
	mboxes = <&mailbox 0>;
	st,rp-name = "CAN_SS";
	st,rp-fw-name = "stm-rproc0-fw.bin";
	status = "disabled";
};
```

## sources/linux/Documentation/devicetree/bindings/spi/spidev.txt
```
This supports access to SPI devices using normal userspace I/O calls.
In other words, one spi device for which there is no kernel driver
for it yet might be accessed relying on the spidev instead.

The spidev node requires the following properties:

- compatible: Name of SPI device. Should be one of the following strings:

	static const struct of_device_id spidev_dt_ids[] = {
		{ .compatible = "rohm,dh2228fv" },
		{ .compatible = "st,sta662" },
		{},
	};

- reg: Chip select address of device.
- spi-max-frequency: Maximum SPI clocking speed of device in Hz.

See spi-bus.txt file for other optional properties that apply to a spi
device node.

SPI device example for an IMX28 SPI bus:

	spi3 {
		compatible = "spi-gpio";
		pinctrl-names = "default";
		pinctrl-0 = <&spi3_pins_cfa10049>;
		status = "okay";
		gpio-sck = <&gpio0 24 0>;
		gpio-mosi = <&gpio0 28 0>;
		cs-gpios = <&gpio0 17 0 &gpio0 26 0 &gpio0 27 0>;
		num-chipselects = <3>;
		#address-cells = <1>;
		#size-cells = <0>;

		dac0: dh2228@2 {
			compatible = "rohm,dh2228fv";
			reg = <2>;
			spi-max-frequency = <100000>;
		};
};

SPI device example for an STA1295 SPI bus:

	spi2: spi@50050000 {
		pinctrl-names = "default";
		pinctrl-0 = <&spi2_default_mux>;
		num-cs = <1>;
		spidev@0 {
			compatible = "st,sta662";
			spi-max-frequency = <1000000>;
			reg = <0>;
			spi-cpol;
			spi-cpha;
			pl022,hierarchy = <0>;
			pl022,interface = <0>;
			pl022,duplex = <0>;
		};
	};
```
