## sources/linux/Documentation/devicetree/bindings/hwspinlock.txt
```
HWSPINLOCK

Required properties:
  - compatible : should be "<manufacturer>,<type>"
  - reg : offset and length of the register set for the device
  - base-id : the base id for this hwspinlock device

Optional properties:

   - interrupts : should contain hwspinlock controller interrupt

Example:

hsem@481b0000 {
	compatible = "st,sta-hsem";
	reg = <0x481b0000 0x1000>;
	base-id = <0>;
};
```

## sources/linux/Documentation/devicetree/bindings/iio/adc/sta-saradc.txt
```
Device Tree bindings for STMicroelectronics Successive Approximation ADC
and resistive touch screen driver.

Required properties:
 - compatible: Should be "st,sta-saradc"
 - reg: Offset and length of the register set for the ADC device.
 - interrupts: The interrupt number for the ADC device.
 - clocks: The root clock of the ADC controller.
 - clock-names: clock alias, must be equal to "apb_pclk".
 - #io-channel-cells = <1>;

Optional properties:
- st,tsc-enable: Enable the touchscreen functionality. If disabled,
	adc channels [0-3] become free for general purpose usage.
- st,averaging-samples: Averaging Control
	00 = 1 sample (No Averaging)
	01 = 2 samples
	10 = 4 samples
	11 = 8 samples
- st,tracking-index: Window Tracking Index
	It is the minimum expected difference between previous
	and current coordinates that identify a new acquisition.
	Condition needs to be true for both X and Y.
	000 = No Window Tracking (Difference must at least be 1)
	001 = 4
	010 = 8
	011 = 16
	100 = 32
	101 = 64 (The value 48 has been intentionally omitted)
	110 = 92
	111 = 127
- st,volt-settling-time: Panel Voltage Settling Time
	Delays from the time when the touch screen analog buffers
	are enabled to the time when the sampling starts.
	000 = 10 us
	001 = 100 us
	010 = 500 us
	011 = 1 ms
	100 = 5 ms
	101 = 10 ms
	110 = 50 ms
	111 = 100 ms
- st,touch-detect-delay: Touch Detect Delay
	Delay upon a touch is detected.
	000 = 10 us
	001 = 50 us
	010 = 100 us
	011 = 500 us
	100 = 1 ms
	101 = 5 ms
	110 = 10 ms
	111 = 50 ms
- st,samples-per-second: Define interval between 2 samples reading.
- st,swap-xy: Permutes x, y axis.
- st,flip-x: Invert x axis.
- st,flip-y: Invert y axis.

Example:

saradc: adc@48110000 {
	compatible = "st,sta-saradc";
	reg = <0x48110000 0x1000>;
	interrupts = <GIC_SPI 8 IRQ_TYPE_LEVEL_HIGH>;
	clocks = <&pclksaradc>;
	clock-names = "apb_pclk";
	#io-channel-cells = <1>;
	st,tsc-enable;
	st,averaging-samples = <3>;
	st,tracking-index = <7>;
	st,volt-settling-time = <0>;
	st,touch-detect-delay = <2>;
	st,samples-per-second = <0>;
	st,swap-xy;
	st,flip-x;
	st,flip-y;
};
```

## sources/linux/Documentation/devicetree/bindings/input/st-dcoadc-keys.txt
```
STMicroelectronics DC Offset ADC driver for keys

The DC 0ffset ADC is able to trigger interrupt on the detection of a DC offset
in an analog signal. This feature can be used to use when the ADC channels are
connected to push buttons.


Required properties:

 - compatible:	   "st,dcoadc-keys"
 - reg:		   register base address and size of the DCO ADC
 - interrupts:     interrupt of the DCO ADC
 - clocks:	   clock of the DCO ADC
 - clock-names:    "apb_pclk"
 - st,adc-channel: sub-node property, describe the ADC channel on which the
		   key is connected
 - st,key-code :   sub-node property,the Linux key code that should be reported
		   as input event for this key

Optional properties:

 - "st,active-high":    sub-node property, to specify the GPIO is active high.
		        By default, keys are considered as active low
 - "st,adc-thresholds": sub-node property, to specify specific thresholds for
			the channel.
			1st cell: Upper Threshold
			2nd cell: Lower Threshold
			The default threshold are 0xffffffff and 0x175

Example:

dcoadc: adc-keys@481c0000 {
	compatible = "st,dcoadc-keys";
	reg = <0x481c0000 0x1000>;
	interrupts = <GIC_SPI 80 IRQ_TYPE_LEVEL_HIGH>;
	clocks = <&pclksaradc>;
	clock-names = "apb_pclk";
	key1 {
		st,adc-channel = <3>;
		st,key-code = <106>; /* Right */
	};
	key2 {
		st,adc-channel = <4>;
		st,key-code = <105>; /* Left */
	};
};
```

## sources/linux/Documentation/devicetree/bindings/input/touchscreen/exc3132.txt
```
* EXC3132 Multiple Touch Controller

Required properties:
- compatible: must be "ampire,exc3132"
- reg: i2c slave address
- interrupt-parent: the phandle for the interrupt controller
- interrupts: touch controller interrupt
- reset-gpio: the gpio pin to be used to reset the controller

Example:
	exc3132: exc3132@2a {
		compatible = "ampire,exc3132";
		reg = <0x2a>;
		interrupt-parent = <&gpio1>;
		interrupts = <16 0>;
		reset-gpio = <&gpio_m3 15 1>;
	};
```

## sources/linux/Documentation/devicetree/bindings/mailbox/st,tuner_backup.txt
```
STMicroelectronics Mailbox service for tuner context backup
-----------------------------------------------------------

Rquired properties:
 - compatible: "st,tuner_backup"
 - mboxes: phandle to a specific mailbox channel
	   refer to sta-mailbox.txt

Example:
	tuner_backup {
		compatible = "st,tuner_backup";
		mboxes = <&mailbox 2>;
	};
```

## sources/linux/Documentation/devicetree/bindings/mailbox/sta-mailbox-test.txt
```
STMicroelectronics Mailbox Test Driver

Required properties:
- compatible		: "st,mailbox-test"
- mboxes		: phandles to sta-mailbox DT node(s)
			  The (n*2) cells are sta-mailbox contoller phandles
			  The ((n+1)*2) cells give the channel number dedicated
			  to the test driver.

See sta-mailbox.txt for the mailbox controller bindings.

Examples:

	mailbox_test {
		compatible = "st,mailbox-test";
		mboxes = <&mailbox 1 &mailbox 2 &mailbox 3
			  &mailbox 4 &mailbox 5 &mailbox 6
			  &mailbox 7 &mailbox 8 &mailbox 9
			  &mailbox 10 &mailbox 11 &mailbox 12
			  &mailbox 13 &mailbox 14 &mailbox 15>;
	};
```

## sources/linux/Documentation/devicetree/bindings/mailbox/sta-mailbox.txt
```
STMicroelectronics Mailbox Driver

Required properties:
- compatible		: Should be one of the following:
			  "st,sta-mailbox" for STA SoCs relying on
			  MBOX HW IP for interrupt generation.
			  "st,sta-mailboxhsem" for STA SoCs relying on
			  HSEM HW IP for interrupt generation.
- #mbox-cells		: Standard mailbox property. Number of cells in the
			  mailbox specifier. Only one cell is used in the STA
			  maibox driver, and it must specify the channel number
- reg			: Contains the physical base address and length of
			  mailbox's registers and shared memory
- reg-names		: Should contain the reg name "mbox-reg", "mbox-rp-reg"
			  and "mbox-shm". The name "mbox-rp-reg" depicts the
			  remote processor registers and is optional.
- interrupts		: Contains the IRQ line for the mailbox. The format is
			  dependent on which interrupt controller the device
			  uses

Optional properties
 - st,mbox-rx-size	: Size allocated in shared memory for Rx message for
			  each channel. Total memory impact for Rx messages is:
			  (st,mbox-rx-size) * (number of channels(=16))
			  If not specified, default rx-size is 0x10.
 - st,mbox-tx-size	: Size allocated in shared memory for Tx message for
			  each channel.

Examples:

/* STA */
mailbox: mailbox@48190000 {
	compatible = "st,sta-mailbox";
	reg = <0x48190000 0x1000>, <0x481a0000 0x1000>, <0x70002000 0x1000>;
	reg-names = "mbox-reg", "mbox-rp-reg", "mbox-shm";
	#mbox-cells = <1>;
	mbox-name = "m3";
	interrupts = <GIC_SPI 63 IRQ_TYPE_LEVEL_HIGH>;
	st,mbox-rx-size = <0x10>;
	st,mbox-tx-size = <0x10>;
};
```

## sources/linux/Documentation/devicetree/bindings/media/st,sta_rvcam.txt
```
* STMicroelectronics Rear View Camera driver

Required properties:
- compatible: Should be "st,sta_rvcam"

Examples:

	rvcam: rvcam {
		compatible = "st,sta_rvcam";
		status = "disabled";
	};
```

## sources/linux/Documentation/devicetree/bindings/media/st,sta_tvdec.txt
```
* STMicroelectronics TV decoder virtual driver

Required properties:
- compatible: Should be "st,sta_tvdec"

Examples:

	tvdec: tvdec {
		compatible = "st,sta_tvdec";
		port {
			tvdec_1: endpoint {
				remote-endpoint = <&vip_0>;
			};
		};
	};
```

## sources/linux/Documentation/devicetree/bindings/media/st,sta_vip.txt
```
* STMicroelectronics Video Input Port driver

Required properties:
- compatible: Should be "st,sta_vip"
- input: Analog source input
- reg: Address and length of the register set for both VIP and SGA devices
- reg-names: Register name for VIP("vip_regs") and SGA("sga_regs")
  respectively
- interrupts: Should contain 3 GIC Interrupt lines, VIP(Line&Frame Interrupts)
  and SGA interrupt line

Optional properties:
- clocks: If present, the first clock should be the VIP main clock and the
  second clock should be SGA clock.
- clock-names: One name for each entry in the clocks property, the first one
  should be "apb_pclk" and the second one should be "sga_clk".
- pwr-gpio: If any, defines Power GPIO pins that power up the device
- reset-gpio: If any, defines Reset GPIO pins that resets the device

Examples:

	vip: vip@48800000 {
		compatible = "st,sta_vip";
		input = <0x2>;
		reg = <0x48800000 0x20000>,  /* VIP Registers */
		      <0x48700000 0x800>;
		reg-names = "vip_regs", "sga_regs";
		interrupts = <GIC_SPI 48 IRQ_TYPE_LEVEL_HIGH>,
			     <GIC_SPI 49 IRQ_TYPE_LEVEL_HIGH>,
			     <GIC_SPI 47 IRQ_TYPE_LEVEL_HIGH>;
		clocks = <&hclkvip>, <&hclkgae>;
		clock-names = "apb_pclk", "sga_clk";
		status = "disabled";
	};
```

## sources/linux/Documentation/devicetree/bindings/misc/i2c-iac20.txt
```
I2C compatible with embedded iPod Authentication Coprocessor 2.0C

Required properties:
- compatible : shall be one of:
	"apple,iac20"


Example:
	iac20@11 {
		compatible= "apple,iac20";
		reg= <0x11>;
		reset-gpio = <&gpio_s 11 0>;
	};
```

## sources/linux/Documentation/devicetree/bindings/mtd/sta-quadspi.txt
```
* ST Microelectronics Automotive Serial Quad Interface (SQI)

Required properties:
  - compatible : Should be "st,sta-qspi"
  - reg : the first contains the register location and length,
          the second contains the memory mapping address and length
  - reg-names: Should contain the reg names "sqi-regs" and "sqi-mmap"
  - interrupts : Should contain the interrupt for the device
  - clocks : The clocks needed by the QuadSPI controller
  - clock-names : the name of the clocks

Example:

qspi0: sqi@50200000 {
	compatible = "st,sta-qspi";
	#address-cells = <1>;
	#size-cells = <0>;
	reg = <0x50200000 0x200>,
	      <0x90000000 0x08000000>;
	reg-names = "sqi-regs", "sqi-mmap";
	interrupts = <GIC_SPI 6 IRQ_TYPE_LEVEL_HIGH>;
	clocks = <&sqiclk>;
	clock-names = "sqiclk";

	pinctrl-names = "default";
	pinctrl-0 = <&sqi_default_mux>;

	flash0: serial-flash@0 {
		#address-cells = <1>;
		#size-cells = <1>;
		spi-max-frequency = <133000000>;
	};
};
```

## sources/linux/Documentation/devicetree/bindings/net/sta-dwmac.txt
```
STMicroelectronics STA SoC family: DWMAC glue layer controller

Required properties:
 - compatible	: "st,sta1295-dwmac", "snps,dwmac-4.10a"
		  Must specify both the glue and dwmac core compatibilities
 - sta,misc-reg : phandle of the syson node that describes the STA MISC register bank

For all other required/optional propreties, please refer to stmmac.txt.

Example:
		ethernet0: dwmac@500a0000 {
			compatible = "st,sta1295-dwmac", "snps,dwmac-4.10a";
			reg = <0x500a0000 0x2000>;
			reg-names = "stmmaceth";
			interrupts = <GIC_SPI 64 IRQ_TYPE_LEVEL_HIGH>;
			interrupt-names = "macirq";
			clocks = <&pclketh>, <&ethptpclk>;
			clock-names = "stmmaceth", "clk_ptp_ref";
			sta,misc-reg = <&mscr>;
		};
```

## sources/linux/Documentation/devicetree/bindings/panel/ampire,am-1280800p2tzqw-t01h.txt
```
Ampire AM-1280800P2TZQW-T01H 7" (1280x800 pixels) TFT LCD panel

Required properties:
- compatible: should be "ampire,am-1280800p2tzqw-t01h"

This binding is compatible with the simple-panel binding, which is specified
in simple-panel.txt in this directory.
```

## sources/linux/Documentation/devicetree/bindings/panel/chunghwa,claa103wa02xn.txt
```
Chunghwa CLAA103WA02XN 10.3" (1280x480 pixels) TFT LCD panel

Required properties:
- compatible: should be "chunghwa,claa103wa02xn"

This binding is compatible with the simple-panel binding, which is specified
in simple-panel.txt in this directory.
```

## sources/linux/Documentation/devicetree/bindings/panel/chunghwa,claa123fca1xn.txt
```
Chunghwa CLAA123FCA1XN 12.3" (1920x720 pixels) TFT LCD panel

Required properties:
- compatible: should be "chunghwa,claa123fca1xn"

This binding is compatible with the simple-panel binding, which is specified
in simple-panel.txt in this directory.
```

## sources/linux/Documentation/devicetree/bindings/panel/rocktech,rk070er9427-ct.txt
```
Rocktech RK070ER9427-CT 7" (800x480 pixels) TFT LCD panel

Required properties:
- compatible: should be "rocktech,rk070er9427-ct"

This binding is compatible with the simple-panel binding, which is
specified in simple-panel.txt in this directory.
```

## sources/linux/Documentation/devicetree/bindings/phy/sta1295-usb-phy.txt
```
STMICROELECTRONICS STA1295 USB2 PHY

Required properties:
 - compatible: st,sta1295-usb2-phy
 - reg/reg-names: offset and length of the PHY registers
 (only needed if CDP feature enabled)  USB0 controller / USB1 controller
 - interrupts/interuppt-names:
 (only needed if CDP feature enabled) IRQ of USB0 and USB1 controller
 - st,misc_reg: offset and length of the MISC registers
 - #phy-cells: must be 0

Refer to phy/phy-bindings.txt for the generic PHY binding properties

Optional parameters
-st,usb0_mode: It offers the default mode selection for USB0, it can be
"DEVICE" or "HOST"
-st,usb1_mode: It offers the default mode selection for USB1, it can be
"DEVICE" or "HOST"
-st,usb0_cdp / usb0_regs : Enable the CDP feature for USB0 / indicate the
register base of USB0 controller as it's a common irq between USB controller
and usb phy
-st,usb1_cdp / usb1_regs : Enable the CDP feature for USB1 / indicate the
register base of USB1 controller as it's a common irq between USB controller
and usb phy
- st,xcver_trim0: tuning register setting for XCVER_TRIM0. Applied only when
supplied value is non-zero.
- st,xcver_trim1: tuning register setting for XCVER_TRIM1. Applied only when
supplied value is non-zero.

Example:
		usbphy: usb-phy@48440000 {
			compatible = "st,sta1295-usb2-phy";
			reg = <0x48440000 0x1000>,
			      <0x48400000 0x1000>;
			reg-names = "phy_regs", "usb0_regs";
			st, usb0_mode = DEVICE;
			st,usb0_cdp;
			usb0_regs = <0x48400000 0x1000>;
			interrupts = <GIC_SPI 20 IRQ_TYPE_LEVEL_HIGH>,
			interrupt-names = "usb0_irq";
			#phy-cells = <0>;
			clocks = <&pclkapbreg>;
			clock-names = "apbreg_clk";
		};
```

## sources/linux/Documentation/devicetree/bindings/pinctrl/st,sta-pinctrl.txt
```
STMicroelectronics Automotive car processor pinmux controller

Required properties:
- compatible: "st,sta1295-pinctrl", "st,sta1385-pinctrl"
- nomadik-gpio-chips: array of phandles to the corresponding GPIO chips
              (these have the register ranges used by the pin controller).

Please refer to:

- pinctrl-bindings.txt in this directory for details of the
  common pinctrl bindings used by client devices, including the meaning of the
  phrase "pin configuration node".

- ste,nomadik.txt in this directory for details about pinctrl nodes and
  sub-nodes configuration.
```
