## sources/linux/Documentation/devicetree/bindings/arm/st,sta.txt
```
STMicroelectronics Automotive Platforms Device Tree Binding

The STMicroelectronics Automotive System On Chip family provides a cost
effective microprocessor solution for modern car radio and telematics systems,
with an embedded Digital Sound Processing subsystem, as well as an ARM
dual Cortex A7 processor. In addition, an ARM Cortex M3 controller is dedicated
for real-time CAN / Vehicle Interface Processing.

While STA1295 SoC embeds a powerful gpu as well as an efficient video decoder,
and is targeted for car radio systems, the STA1385 variant has neither
multimedia features nor Digital Sound Processing but embeds one additional
Cortex M0 dedicated to enhanced security features and is well suited for
telematics applications.

Each device tree must specify which STA SoC it uses,
using one of the following compatible strings:

  st,sta1295
  st,sta1195
  st,sta1385
  st,sta1275
```

## sources/linux/Documentation/devicetree/bindings/clock/st/st,sta.txt
```
Clock driver for the STMicroelectronics Automotive car processors

Author: Jean-Nicolas graux <jean-nicolas.graux@st.com>

This binding uses the common clock binding:
Documentation/devicetree/bindings/clock/clock-bindings.txt

There are 3 peripherals that control clocks in the STA1295/STA1385
SoCs, namely the SRC-M3, the SRC-A7 and the A7-SSC.

- SRC-M3:
	- Operating mode of main SRC Finite State Machine.
	- FVCO configuration of PLL2, PLL3, PLL4 and PLLDDR.
	- Enabling, disabling of the PLL2, PLL3, PLL4 and PLLDDR.
	- Clock source divider configuration of Multimedia Timer
	  Units 0, 1.
	- Enabling, disabling, status of main crystal.
	- SoC software reset and SoC reset status.
	- Programmable clock source selection/divider of following
	  peripherals:
		- SDIO0, SDMMC1, SDMMC2
		- Video decoder
		- Graphic accelerator (sta1295)
		- CLCD controller (sta1295)
		- CAN subsystem
		- Audio subsystem
		- SQI
	- Control of external output clocks
	- Clocks gating of most of the SoC peripheral functional clocks
- SRC-A7:
	- PHI configuration of PLL3 and PLLDDR
	- SoC Reset status
	- Programmable clock source selection/divider of following
	  peripherals:
		- ETM Trace
		- HCLK
	- Clocks gating of most of the SoC peripheral bus clocks

- The A7 Sub-System Controller (A7 SSC):
	- FVCO & PHI programming of PLLARM (= PLL1)
	- Enabling, disabling of PLLARM
	- clock source selection of C-A7 subsystem

To get a detailed description about the distribution of functionalities
between SRC-M3, SRC-A7 and A7-SSC peripherals, get a look to "System
Reset Controller (SRC-M3/SRC-A7/A7-SSC) chapter from sta1295, STA1385
User Manual.

SRC nodes:
----------

Required properties for the SRC-M3 node:

- compatible: either "st,sta1295-src-m3-clk" or "st,sta1385-src-m3-clk"
- #clock-cells: must be 1

Example:
	srcm3_clk: srcm3@40020000 {
		compatible = "st,sta1295-src-m3-clk";
		reg = <0x40020000 0x100>;
		#clock-cells = <1>;
	};

Required properties for the SRC-A7 node:

- compatible: "st,sta1295-src-a7"
- #clock-cells: must be 1

Example:
	srca7_clk: srca7@48100000 {
		compatible = "st,sta1295-src-a7-clk";
		reg = <0x48100000 0x100>;
		#clock-cells = <1>;
	};

A7-SSC node:
------------

Required properties for the A7-SSC node:

- compatible: "st,sta1295-a7-ssc-clk"
- #clock-cells: must be 1

Example:
	a7ssc_clk: a7ssc@68000000 {
		compatible = "st,sta1295-a7-ssc-clk";
		reg = <0x68000000 0x100>;
		#clock-cells = <1>;
	};

Clock bindings in peripheral nodes:
-----------------------------------

#include <dt-bindings/clock/sta-clock.h>

uart1: uart@50000000 {
	compatible = "arm,pl011", "arm,primecell";
	reg = <0x50000000 0x1000>;
	interrupts = <GIC_SPI 25 IRQ_TYPE_LEVEL_HIGH>;
	clocks = <&srcm3_clk STA_CLK_UART1>,
		 <&srca7_clk STA_CLK_PUART1>;
	clock-names = "uartclk", "apb_pclk";
	dmas = <&dmasel 0 12 2>, <&dmasel 0 16 2>;
	dma-names = "rx", "tx";
};
```

## sources/linux/Documentation/devicetree/bindings/cpufreq/sta-cpufreq.txt
```
STMicroelectronics STA1xxx cpu freqrency scaling

Required properties:
- compatible:	must be "st,sta-cpufreq"
- clocks:	clock used to scale the cpus
- clock-names:	must be "cpu_clk"

Example:

cpu_freq: cpu_freq@0 {
	compatible = "st,sta-cpufreq";
	clocks = <&a7ssc_clk STA_CLK_CPU>;
	clock-names = "cpu_clk";
};
```

## sources/linux/Documentation/devicetree/bindings/crypto/st,ccc.txt
```
* ST Microelectronics hardware cryptographic accelerators controller

This a configurable controller that host hardware cryptographic accelerators
found on some ST products.

* C3 Channel Controller (CCC)

Acts as a bus controller where cryptographic accelerators, namely channels, are
plugged in. These channels can be either MPAES HASH TRNG or PKA channels among
some others.

Required properties:
- compatible: Should be "st,ccc-v3.0".
- reg: "c3_base" should contain C3 registers location and length.
  "c3_program" should set DMA memory size for C3 microcode.
- interrupts: Should contain the interrupt line for the C3.
- interrupt-names: Should be "c3_irq".
- clocks: List of clocks for C3.
- clock-names: Should be "c3_hclk".
- enabled-dispatchers: u8 bit field to enable dispatcher one by one.

Example:
ccc: ccc@49000000 {
	compatible = "st,ccc-v3.0";
	reg = <0x49000000 0x6000>, <0x0 0x1000>;
	reg-names = "c3_base", "c3_program";
	interrupts = <GIC_SPI 68 IRQ_TYPE_LEVEL_HIGH>;
	interrupt-names = "c3_irq";
	clocks = <&hclkc3>;
	clock-names = "c3_hclk";
	enabled-dispatchers = /bits/ 8 <3>;
};
```

## sources/linux/Documentation/devicetree/bindings/crypto/st,mpaes.txt
```
* ST Microelectronics hardware cryptographic accelerator

This is an AES hardware cryptographic accelerator found on some ST products.

* Micro-Programmable Advanced Encryption Standard (MPAES)

This hardware cryptographic accelerator is likely to be a channel of a C3
Channel Controller (see st,ccc.txt). Therefore this channel, as others do, must
be a child of a C3 device tree node.

Required properties:
- compatible: Should be "st,mpaes-v0.3".
- index: u8, from 0 to 15, where is located the channel in C3 hardware
  implementation.
- gp-key-slots: u16 bit field to depict available general purpose key slots.

Example:
mpaes@2 {
	compatible = "st,mpaes-v0.3";
	index = /bits/ 8 <2>;
	gp-key-slots = /bits/ 16 <0xfffc>;
};
```

## sources/linux/Documentation/devicetree/bindings/crypto/st,pka.txt
```
* ST Microelectronics hardware cryptographic accelerator

This is a RSA hardware cryptographic accelerator found on some ST products.

* Public Key Accelerator (PKA)

This hardware cryptographic accelerator is likely to be a channel of a C3
Channel Controller (see st,ccc.txt). Therefore this channel, as others do, must
be a child of a C3 device tree node.

Required properties:
- compatible: Should be "st,pka-v0.7".
- index: u8, from 0 to 15, where is located the channel in C3 hardware
  implementation.
- countermeasure: power analysis countermeasure selection:
  0 for no countermeasure, 1 for SPA, 2 for DPA.

Example:

ccc: ccc@49000000 {
	status = "disabled";
	compatible = "st,ccc-v3.0";
	reg = <0x49000000 0x6000>, <0x0 0x2000>;
	reg-names = "c3_base", "c3_prog";
	interrupts = <GIC_SPI 68 IRQ_TYPE_LEVEL_HIGH>;
	interrupt-names = "c3_irq";
	clocks = <&srca7_clk STA_CLK_HC3>;
	clock-names = "c3_hclk";
	enabled-dispatchers = /bits/ 8 <1>;

	mpaes@1 {
		compatible = "st,mpaes-v0.3";
		index = /bits/ 8 <1>;
		gp-key-slots = /bits/ 16 <0xfffc>;
	};

	pka@2 {
		compatible = "st,pka-v0.7";
		index = /bits/ 8 <2>;
		countermeasure = <2>;
	};
};
```

## sources/linux/Documentation/devicetree/bindings/dma/sta-dmasel.txt
```
STMicroelectronics STA1xxx DMA SEL (DMA signals routing over DMA0 or DMA1)

Required properties:
- compatible:	"st,sta1295-dmasel"
- reg:		Memory map for accessing module.
- #dma-cells:	Should be set to <3>.
		* 1st cell contains 0 or 1 depending on the dma engine used.
		* 2nd cell contains the id of the dma request line (0-31).
		* 3rd cell contains either 1 or 2 depending on the AHB master
		  used.
- dmacs:	phandle list pointing to DMA controllers in right order.
		dma0 must be the first in the list followed by dma1.

Example:

dma0: dma@48200000 {
	compatible = "arm,pl080", "arm,primecell";
	arm,primecell-periphid = <0x00280080>;
	reg = <0x48200000 0x1000>;
	interrupts = <GIC_SPI 18 IRQ_TYPE_LEVEL_HIGH>;
	clocks = <&hclkdma0>;
	clock-names = "apb_pclk";
	#dma-cells = <2>;
	lli-bus-interface-ahb2;
	mem-bus-interface-ahb2;
	memcpy-bus-width = <32>
};

dma1: dma@48300000 {
	compatible = "arm,pl080", "arm,primecell";
	arm,primecell-periphid = <0x00280080>;
	reg = <0x48300000 0x1000>;
	interrupts = <GIC_SPI 19 IRQ_TYPE_LEVEL_HIGH>;
	clocks = <&hclkdma1>;
	clock-names = "apb_pclk";
	#dma-cells = <2>;
	lli-bus-interface-ahb2;
	mem-bus-interface-ahb2;
	memcpy-bus-width = <32>
};

mscr: syscon@50700000 {
			compatible = "st,sta1295-mscr-a7", "syscon", "simple-mfd";
			reg = <0x50700000 0x1000>;
			clocks = <&pclkapbreg>;

			dmasel: dmasel@0 {
				compatible = "st,sta1295-dmasel";
				#dma-cells = <3>;
				dmacs = <&dma0>, <&dma1>;
			};
};

uart0: uart@50150000 {
	compatible = "arm,pl011", "arm,primecell";
	reg = <0x50150000 0x1000>;
	interrupts = <GIC_SPI 24 IRQ_TYPE_LEVEL_HIGH>;
	clocks = <&uart0clk>, <&pclkuart0>;
	clock-names = "uartclk", "apb_pclk";
	dmas = <&dmasel 0 11 2>, <&dmasel 0 15 2>;
	dma-names = "rx", "tx";
};
```

## sources/linux/Documentation/devicetree/bindings/gpu/st,gcnano.txt
```
Vivante gcnano GPU integration into STMicroelectronics platform

- gcnano: Vivante gcnano GPU ip
  Required properties:
  - compatible: "st,gcnano"
  - reg:
      - Physical base address of the ip registers and length of memory mapped
        region.
      - Reserved memory region (contiguous memory region) used by the Vivante
        software stack (minimum is 32MB, recommended is greater than 192MB).
  - reg-names: names of the mapped memory regions listed in regs property in
    the same order.
  - cloks: clocks to be managed by the driver
  - clock-names: names of the clocks listed by clocks property in the same order
  - interrupts: GPU interrupt for the 3D pipeline
  - interrupt-names: names of the interrupts listed in interrupts property in
    the same order.

Device node example:

/ {
	...

		gcnano@48F00000 {
			compatible = "st,gcnano";
			reg = <0x48F00000 0x800>,
			      <0xD4000000 0xC000000>,  /*192MB reserved memory*/
			reg-names = "iobase_3d",
				    "contig_baseaddr",
			clocks = <&hclkgfx>, <&aclkgfx>;
			clock-names = "clk_3d_ahb", "clk_3d_axi";
			interrupts = <GIC_SPI 66 IRQ_TYPE_LEVEL_HIGH>;
			interrupt-names = "irq_3d";
		};


	...
};
```

## sources/linux/Documentation/devicetree/bindings/gpu/st,ltdc.txt
```
STMicroelectronics platforms with ltdc IP display controller.

- sta-display-subsystem: Master device for drm sub-components
  This device must be the parent of all the sub-components and is responsible of bind them.
  Required properties:
  - compatible: "st,display-subsystem"
  - ranges: to allow probing of subdevices

- clcd: lcd tft controller with composition capabilities, must be a child of sta-display-subsystem
  Required properties:
  - compatible: "st,ltdc"
  - interrupts : Display Controller interrupt numbers to the CPU.
  - reg: Physical base address of the ip registers and length of memory mapped region.
  - clocks: from common clock binding: handle hardware ip needed clocks, the number of clocks may depend of the soc type.
    See ../clocks/clock-bindings.txt for details.
  - bus-width: width in bits of the display controller data bus
  - port: a port pointing to a remote display panel phandle

  Optional properties:
  - resets: resets to be used by the device. See ../reset/reset.txt for details.

Device node example:

		sta-display-subsystem {
			compatible = "st,display-subsystem";
			ranges;

			clcd@48600000 {
				compatible = "st,ltdc";
				reg = <0x48600000 0x10000>, <0x50700000 0x10000>;
				reg-names = "clcd", "misc";
				interrupts = <GIC_SPI 46 IRQ_TYPE_LEVEL_HIGH>;
				clocks = <&hclkclcd>, <&clcdclk>;
				clock-names = "clk", "lcd_clk";
				bus-width = <64>;
				port {
					clcd_out: endpoint {
						remote-endpoint = <&mi0700sat3_in>;
					};
				};
			};
		};

		panel_rgb: panel-rgb {
			compatible = "multi-inno,mi0700sat3";

			reg = <0x50110000 0x100>; /* EFT3 / PWM control */

			pinctrl-names = "default";
			pinctrl-0 = <&clcd_default_mux &eft3_default_mux>;

			panel-width-mm = <154>;
			panel-height-mm = <86>;

			display-timings {
				timing {
					clock-frequency = <33264000>;
					hactive = <800>;
					vactive = <480>;
					hback-porch = <26>;
					hfront-porch = <210>;
					vback-porch = <13>;
					vfront-porch = <22>;
					hsync-len = <20>;
					vsync-len = <10>;
					hsync-active = <1>;
					vsync-active = <1>;
				};
			};

			port {
				mi0700sat3_in: endpoint {
					remote-endpoint = <&clcd_out>;
				};
			};
		};
```
