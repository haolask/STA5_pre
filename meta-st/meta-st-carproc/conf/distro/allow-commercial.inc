## meta-st/meta-st-carproc/conf/distro/allow-commercial.inc
```bitbake
DISABLE_GPLv3_PACKAGES ?= ""
LICENSE_FLAGS_WHITELIST += "${@bb.utils.contains('DISABLE_GPLv3_PACKAGES', 'true', '', ' commercial', d)}"
```

## meta-st/meta-st-carproc/conf/distro/poky-st-NoGPLv3.conf
```bitbake
#@NAME: poky-st-NoGPLv3
#@DESCRIPTION: poky-st without GPLv3 packages

require poky-st.conf

DISABLE_GPLv3_PACKAGES = "true"
DISTRO = "poky-st-NoGPLv3"
```

## meta-st/meta-st-carproc/conf/distro/poky-st.conf
```bitbake
#@NAME: poky-st
#@DESCRIPTION: Basic poky configuration

require conf/distro/poky.conf
include allow-commercial.inc

#Rename poky distro to poky-st, because we amend it
DISTRO = "poky-st"

DISTRO_FEATURES_remove ?= "x11 3g nfc"

DISTRO_FEATURES_BACKFILL_CONSIDERED += "pulseaudio"

# add support of systemd
DISTRO_FEATURES_append = " systemd wifi"
DISTRO_FEATURES_append = " ${@'tpm' if os.path.isfile('${OEROOT}/meta-security/conf/layer.conf') else ''}"
DISTRO_FEATURES_BACKFILL_CONSIDERED += "sysvinit"
VIRTUAL-RUNTIME_init_manager = "systemd"
VIRTUAL-RUNTIME_initscripts = "systemd-compat-units"

DISTRO_FEATURES[vardepsexclude] = "OEROOT"

### LICENSES ###
INCOMPATIBLE_LICENSE = "GPLv3.0 GPLv3 GPL-3.0 GPLv3+ LGPLv3.0 LGPLv3 LGPL-3.0 LGPLv3+"

OPENSDK_WHITELIST_GPLv3 = "${@'nano' if os.path.isfile('${OEROOT}/meta-security/conf/layer.conf') else ''}"
OPENSDK_WHITELIST_GPLv3 += "${@'gdb binutils glmark2 iperf' if os.path.isfile('${OEROOT}/meta-st/meta-st-carproc/recipes-core/images/core-image-st-carproc-optional.inc') else ''}"
OPENSDK_WHITELIST_GPLv3 += "${@'qtwebsockets' if os.path.isfile('${OEROOT}/meta-qt5/recipes-qt/qt5/qtwebchannel_git.bb') else ''}"

WHITELIST_GPLv3.0+ = "${OPENSDK_WHITELIST_GPLv3}"
WHITELIST_LGPLv3.0 = "${OPENSDK_WHITELIST_GPLv3}"
WHITELIST_GPL-3.0 = "${OPENSDK_WHITELIST_GPLv3}"
WHITELIST_GPL-3.0+ = "${OPENSDK_WHITELIST_GPLv3}"

#--------------------------
# Tune build config display
#
BUILDCFG_VARS += "GCCVERSION"
BUILDCFG_VARS += "PREFERRED_PROVIDER_virtual/kernel"

#This package is bringup some gnutls deps, which are GPLv3
PACKAGE_EXCLUDE += "glib-networking"
```

## meta-st/meta-st-carproc/conf/layer.conf
```bitbake
# We have a conf and classes directory, add to BBPATH
BBPATH .= ":${LAYERDIR}"

# We have a recipes-* directories, add to BBFILES
BBFILES += "${LAYERDIR}/recipes-*/*/*.bb \
	${LAYERDIR}/recipes-*/*/*.bbappend"

BBFILE_COLLECTIONS += "st-carproc"
BBFILE_PATTERN_st-carproc = "^${LAYERDIR}/"
BBFILE_PRIORITY_st-carproc = "6"

LICENSE_PATH += "${LAYERDIR}/licenses"

LAYER_PATH := "${LAYERDIR}"
```

## meta-st/meta-st-carproc/conf/machine/include/sta1295-base.inc
```bitbake
#@TYPE: Machine
#@NAME: Accordo5 STA1295 EVB board
#@DESCRIPTION: Common machine configuration for Accordo5 STA1295 EVB board

# Enable Cortex A7 thumb neon and hard floating point
DEFAULTTUNE = "cortexa7thf-neon"
include conf/machine/include/sta1xxx-base.inc
include conf/machine/include/sta1295-sw-base.inc
include conf/machine/include/sta1295-default-providers.inc
include conf/machine/include/sta1295-machine-features.inc
include conf/machine/include/tune-cortexa7.inc

#Wifi firmware support
MACHINE_EXTRA_RDEPENDS += "linux-firmware-sd8887"

## MISC ##
SOC_FAMILY = "sta:sta1295"
SERIAL_CONSOLES = "115200;ttyAMA2"

## KERNEL ##
KERNEL_DEVICETREE ?= "sta1295-evb.dtb"
KERNEL_CONFIG_FRAGMENTS ?= "sta1295.config"
KBUILD_DEFCONFIG ?= "sta1295_defconfig"

## M3 bootloaders target configuration ##
# SoC ST1295
TARGET_SOC_ID ?= "SOCID_STA1295"
# Board A5 EVB
TARGET_BOARD_ID ?= "BOARD_A5_EVB"
# Boot on MMC, NAND or SQI
TARGET_BOOT_DEVICE ?= "${MEMORY_BOOT_DEVICE}"

## U-BOOT ##
UBOOT_ENTRYPOINT = "0xA0000000"
UBOOT_LOADADDRESS = "0xA0000000"
#First one should always be for the flashloader, and second for boot
UBOOT_CONFIG ?= "${MEMORY_BOOT_DEVICE} ${MEMORY_BOOT_DEVICE}_XLDR"

UBOOT_CONFIG[NAND] = "sta-nand-flashloader_defconfig,ubifs"
UBOOT_CONFIG[NAND_XLDR] = "sta-nand-xloader_defconfig,ubifs"

UBOOT_CONFIG[MMC] = "sta-mmc-flashloader_defconfig,ext4"
UBOOT_CONFIG[MMC_XLDR] = "sta-mmc-xloader_defconfig,ext4"

UBOOT_CONFIG[SQI] = "sta-sqi-flashloader_defconfig,ubifs"
UBOOT_CONFIG[SQI_XLDR] = "sta-sqi-xloader_defconfig,ubifs"

UBOOT_CONFIG[SQI_NAND] = "sta-sqi-nand-flashloader_defconfig,ubifs"
UBOOT_CONFIG[SQI_NAND_XLDR] = "sta-sqi-nand-xloader_defconfig,ubifs"

UBOOT_CONFIG[SQI_MMC] = "sta-sqi-mmc-flashloader_defconfig,ext4"
UBOOT_CONFIG[SQI_MMC_XLDR] = "sta-sqi-mmc-xloader_defconfig,ext4"

UBOOT_DEVICETREE  = "sta1295-evb"

### GPU ###
MACHINE_FEATURES_append = " gcnanogpuimpl"

### Generic flag to enable MM modules deployment ###
MACHINE_FEATURES_append = " multimedia"

#ETAL
KERNEL_MODULE_AUTOLOAD += "spidev"

#DSP FW
ST_DSP_FW_SUBPATH = "sound/soc/sta/staudiolib/dspfw"
ST_DSP_FW = "emerald-firmware.P.noheader"
ST_DSP_FW += "emerald-firmware.X.noheader"
ST_DSP_FW += "emerald-firmware.Y.noheader"

#EARLY AUDIO
ST_EARLY_AUDIO_SUBPATH = "early_audio"
```

## meta-st/meta-st-carproc/conf/machine/include/sta1295-default-providers.inc
```bitbake
#@DESCRIPTION: Car Processor STA1XXX default providers

MULTI_PROVIDER_WHITELIST += "virtual/libgles1 virtual/libgles2 virtual/egl virtual/mesa"

ST_GCNANO_USERLAND_BACKEND = "gcnano-userland-multi-binary"
# virtual/libgles1
PREFERRED_PROVIDER_virtual/libgles1 = "${@bb.utils.contains('MACHINE_FEATURES', 'gcnanogpuimpl', '${ST_GCNANO_USERLAND_BACKEND}', 'mesa', d)}"
# virtual/libgles2
PREFERRED_PROVIDER_virtual/libgles2 = "${@bb.utils.contains('MACHINE_FEATURES', 'gcnanogpuimpl', '${ST_GCNANO_USERLAND_BACKEND}', 'mesa', d)}"
# virtual/egl
PREFERRED_PROVIDER_virtual/egl = "${@bb.utils.contains('MACHINE_FEATURES', 'gcnanogpuimpl', '${ST_GCNANO_USERLAND_BACKEND}', 'mesa', d)}"
# virtual/mesa
#PREFERRED_PROVIDER_virtual/mesa = "${@bb.utils.contains('MACHINE_FEATURES', 'gcnanogpuimpl', '${ST_GCNANO_USERLAND_BACKEND}', 'mesa', d)}"
# virtual/mesa
PREFERRED_PROVIDER_virtual/mesa = "${@bb.utils.contains('MACHINE_FEATURES', 'gcnanogpuimpl', '${ST_GCNANO_USERLAND_BACKEND}', 'mesa', d)}"
```

## meta-st/meta-st-carproc/conf/machine/include/sta1295-machine-features.inc
```bitbake
#@DESCRIPTION: Car Processor STA1XXX machine features definitions

#------------------
#
# GPU
#
# to support gpu on a machine, please add "gcnanogpuimpl" on machine features
#MACHINE_FEATURES += "gcnanogpuimpl"

GPU_LIST          = "kernel-module-galcore ${ST_GCNANO_USERLAND_BACKEND}"
GPU_IMAGE_INSTALL = "${@bb.utils.contains('MACHINE_FEATURES', 'gcnanogpuimpl', '${GPU_LIST}', '', d)} "
```

## meta-st/meta-st-carproc/conf/machine/include/sta1295-sw-base.inc
```bitbake
EULA_FILE_ST_sta += "${LAYER_PATH}/conf/eula/Vivante"
EULA_FILE_ST_sta += "${LAYER_PATH}/conf/eula/licence_accept"


#Define preferred version for packages
```

## meta-st/meta-st-carproc/conf/machine/include/sta1xxx-base.inc
```bitbake
#@provides the Car Processor STA1XXX platforms common settings

include conf/machine/include/soc-family.inc
include sta1xxx-optionnal-providers.inc

MACHINE_EXTRA_RRECOMMENDS = " kernel-modules kernel-devicetree"

EXTRA_IMAGEDEPENDS += "m3-loaders"
EXTRA_IMAGEDEPENDS +=  "${@bb.utils.contains('MACHINE_FEATURES', 'atf', 'fip-image', 'u-boot', d)}"
EXTRA_IMAGEDEPENDS += "bc-native"

PREFERRED_PROVIDER_virtual/kernel ?= "linux-sta12xx"

#Use linux 4.9 libc headers
LINUXLIBCVERSION = "4.9"

KERNEL_IMAGETYPE ?= "fitImage"
KERNEL_CLASSES ?= " kernel-fitimage "
KERNEL_EXTRA_ARGS += "LOADADDR=${UBOOT_ENTRYPOINT}"

MACHINE_FEATURES_append = " usbgadget usbhost vfat alsa ext4"

IMAGE_BOOT_FILES ?= "u-boot.${UBOOT_SUFFIX}"

# Linux Test Project
PREFERRED_VERSION_ltp ?= "20160126"

# Flashloader config for all generated images
IMAGE_CLASSES += " image-flashloader-config"
IMAGE_CLASSES += " postprocess-image"

#Default size for initramfs (MB)
INITRAMFS_DEFAULT_SIZE = "10"
#Default size for bootfs (MB)
BOOTFS_DEFAULT_SIZE="16"

# ST CarProc baseline paths
#
ST_LOCAL_SRC ?= "${OEROOT}/sources/"
ST_LOCAL_SRC[vardepsexclude] = "OEROOT"
ST_LOCAL_TOOLS ?= "${OEROOT}/tools/"
ST_LOCAL_TOOLS[vardepsexclude] = "OEROOT"
ST_LOCAL_TESTS ?= "${OEROOT}/validation-tests/"
ST_LOCAL_TESTS[vardepsexclude] = "OEROOT"

#Use the GPLv2+ version of bash
PREFERRED_VERSION_bash = "3.2.57"

EULA_FILE_ST_sta = "${LAYER_PATH}/conf/eula/ST_EULA"

UBOOT_SIGN_KEYDIR = "${DEPLOY_DIR_IMAGE}/keys"
UBOOT_SIGN_KEYNAME = "dev"
UBOOT_SIGN_ENABLE = "1"

TOOLCHAIN_HOST_TASK_append = " nativesdk-u-boot-mkimage"

UBOOT_ENV_CONFIG[vardepsexclude] = "LAYER_PATH"
FLASHLOADER_CONFIG[vardepsexclude] = "LAYER_PATH"
SPLASH_ANIMATION_CONFIG[vardepsexclude] = "LAYER_PATH"
SPLASH_CONFIG[vardepsexclude] = "LAYER_PATH"
MEMORY_MAPPING_CONFIG[vardepsexclude] = "LAYER_PATH"
EULA_FILE_ST[vardepsexclude] = "LAYER_PATH"
```

## meta-st/meta-st-carproc/conf/machine/sta1295-boot-m3os-from-m3xl-evb-mmc.conf
```bitbake
#@TYPE: Machine
#@NAME: Accordo5 STA1295 EVB board
#@DESCRIPTION: Machine configuration for Accordo5 STA1295 EVB board with **MMC** memory, with support boot M3 OS from M3 Xloader
#@NEEDED_BSPLAYERS: meta-toolchain-bare-metal

include conf/machine/include/sta1295-base.inc

IMAGE_FSTYPES ?= "ext4"

MEMORY_BOOT_DEVICE = "MMC"

## FLASHLOADER ##
UBOOT_ENV_CONFIG ?= "${LAYER_PATH}/conf/machine/sta1295-uboot-env-mmc.txt"
FLASHLOADER_CONFIG ?= "${LAYER_PATH}/conf/flashloader/config_mmc_boot_m3os_from_m3xl_car_radio.txt"
SPLASH_CONFIG ?= "${LAYER_PATH}/binary/splash_wvga_rgb565.rgb"
SPLASH_ANIMATION_CONFIG ?= "${LAYER_PATH}/binary/splash_animation.mov"

## MEMORY MAPPING ##
MEMORY_MAPPING_CONFIG ?= "${LAYER_PATH}/conf/mapping/sta1295-evb-boot_m3os_from_m3xl-mem-mapping_512M.xml"

MACHINE_FEATURES += "atf boot_m3os_from_m3xl"
```

## meta-st/meta-st-carproc/conf/machine/sta1295-evb-nand.conf
```bitbake
#@TYPE: Machine
#@NAME: Accordo5 STA1295 EVB board
#@DESCRIPTION: Machine configuration for Accordo5 STA1295 EVB board with **NAND** memory
#@NEEDED_BSPLAYERS: meta-toolchain-bare-metal

include conf/machine/include/sta1295-base.inc

IMAGE_FSTYPES ?= "ubifs"

# UBIFS default parameters
MKUBIFS_COMMON_ARGS = "-e 0x7e000 -m 0x1000"
#2048 block for whole NAND - 22 for bootfs - 16 for raw parts
MKUBIFS_ARGS = "${MKUBIFS_COMMON_ARGS} -c 2010"
#Minimal count of LEB is 22 (17 + minimal log LEB)
MKUBIFS_BOOTFS_ARGS = "${MKUBIFS_COMMON_ARGS} -c 22"
BLOCK_SIZE = "512"

MEMORY_BOOT_DEVICE = "NAND"

## FLASHLOADER ##
UBOOT_ENV_CONFIG ?= "${LAYER_PATH}/conf/machine/sta1295-uboot-env-nand.txt"
FLASHLOADER_CONFIG ?= "${LAYER_PATH}/conf/flashloader/config_nand_car_radio.txt"
SPLASH_CONFIG ?= "${LAYER_PATH}/binary/splash_wvga_rgb565.rgb"
SPLASH_ANIMATION_CONFIG ?= "${LAYER_PATH}/binary/splash_animation.mov"

## MEMORY MAPPING ##
MEMORY_MAPPING_CONFIG ?= "${LAYER_PATH}/conf/mapping/sta1295-evb-mem-mapping_512M.xml"

MACHINE_FEATURES += "atf"
MACHINE_FEATURES += "ChainOfTrust"
```

## meta-st/meta-st-carproc/conf/machine/sta1295-evb-sqi-mmc.conf
```bitbake
#@TYPE: Machine
#@NAME: Accordo5 STA1295 EVB board
#@DESCRIPTION: Machine configuration for Accordo5 STA1295 EVB board with **SQI+MMC** memories
#@NEEDED_BSPLAYERS: meta-toolchain-bare-metal

include conf/machine/include/sta1295-base.inc

IMAGE_FSTYPES ?= "ext4"

MEMORY_BOOT_DEVICE = "SQI"
UBOOT_CONFIG = "SQI_MMC SQI_MMC_XLDR"

## FLASHLOADER ##
UBOOT_ENV_CONFIG ?= "${LAYER_PATH}/conf/machine/sta1295-uboot-env-mmc.txt"
FLASHLOADER_CONFIG ?= "${LAYER_PATH}/conf/flashloader/config_sqi_mmc_car_radio.txt"
SPLASH_CONFIG ?= "${LAYER_PATH}/binary/splash_wvga_rgb565.rgb"
SPLASH_ANIMATION_CONFIG ?= "${LAYER_PATH}/binary/splash_animation.mov"

## MEMORY MAPPING ##
MEMORY_MAPPING_CONFIG ?= "${LAYER_PATH}/conf/mapping/sta1295-evb-mem-mapping_512M.xml"

MACHINE_FEATURES += "atf"
MACHINE_FEATURES += "ChainOfTrust"
```

## meta-st/meta-st-carproc/conf/machine/sta1295-evb-sqi.conf
```bitbake
#@TYPE: Machine
#@NAME: Accordo5 STA1295 EVB board
#@DESCRIPTION: Machine configuration for Accordo5 STA1295 EVB board with **SQI** only memory
#@NEEDED_BSPLAYERS: meta-toolchain-bare-metal

include conf/machine/include/sta1295-base.inc

IMAGE_FSTYPES ?= "ubifs"

MEMORY_BOOT_DEVICE = "SQI"

# UBIFS default parameters for up to 64MB serial nor flash
MKUBIFS_COMMON_ARGS = "-F -e 65408 -m 8"
MKUBIFS_ARGS = "${MKUBIFS_COMMON_ARGS} -c 1024"
MKUBIFS_BOOTFS_ARGS = "${MKUBIFS_COMMON_ARGS} -c 96"
BLOCK_SIZE = "64"

## FLASHLOADER ##
UBOOT_ENV_CONFIG ?= "${LAYER_PATH}/conf/machine/sta1295-uboot-env-sqi.txt"
FLASHLOADER_CONFIG ?= "${LAYER_PATH}/conf/flashloader/config_sqi_only.txt"

## MEMORY MAPPING ##
MEMORY_MAPPING_CONFIG ?= "${LAYER_PATH}/conf/mapping/sta1295-evb-mem-mapping_512M.xml"

## SQI on EVB is small, only core-image-minimal can fit in. ##
## Adding extra tools to it ##
CORE_IMAGE_EXTRA_INSTALL += "mtd-utils"
CORE_IMAGE_EXTRA_INSTALL += "mem-access"
CORE_IMAGE_EXTRA_INSTALL += "timestamp"

MACHINE_FEATURES += "atf"
MACHINE_FEATURES += "ChainOfTrust"
```

## meta-st/meta-st-carproc/conf/machine/sta1295-m3xl_load_m3os-no_uboot-mmc.conf
```bitbake
#@TYPE: Machine
#@NAME: Accordo5 STA1295 EVB board
#@DESCRIPTION: Machine configuration for Accordo5 STA1295 EVB board with **MMC** memory, with support boot M3 OS from M3 Xloader and no uboot (ATF direct Linux boot)
#@NEEDED_BSPLAYERS: meta-toolchain-bare-metal

include conf/machine/include/sta1295-base.inc

IMAGE_FSTYPES ?= "ext4"

#Override the default fitImage, as uboot is not present
KERNEL_IMAGETYPE = "zImage"
KERNEL_CLASSES_remove = "kernel-fitimage"

MEMORY_BOOT_DEVICE = "MMC"

## FLASHLOADER ##
UBOOT_ENV_CONFIG ?= "${LAYER_PATH}/conf/machine/sta1295-uboot-env-mmc.txt"
FLASHLOADER_CONFIG ?= "${LAYER_PATH}/conf/flashloader/config_mmc_m3os_load_m3xl_no_uboot_car_radio.txt"
SPLASH_CONFIG ?= "${LAYER_PATH}/binary/splash_wvga_rgb565.rgb"
SPLASH_ANIMATION_CONFIG ?= "${LAYER_PATH}/binary/splash_animation.mov"

## MEMORY MAPPING ##
MEMORY_MAPPING_CONFIG ?= "${LAYER_PATH}/conf/mapping/sta1295-evb-boot_m3os_from_m3xl-mem-mapping_512M.xml"

MACHINE_FEATURES += "atf boot_m3os_from_m3xl no_uboot"
```

## meta-toolchain-bare-metal/conf/layer.conf
```bitbake
# We have a conf and classes directory, append to BBPATH
BBPATH .= ":${LAYERDIR}"

# If we have a recipes directory, add to BBFILES
#BBFILES += "${LAYERDIR}/recipes-*/*/*.bb ${LAYERDIR}/*/recipes-*/*/*.bbappend"
#BBFILE_COLLECTIONS += "tc-bare-metal"
#BBFILE_PATTERN_tc-bare-metal := "^${LAYERDIR}/"
#BBFILE_PRIORITY_tc-bare-metal = "5"

PATH_toolchain-bare-metal_prepend = "${LAYERDIR}/bin/gcc-arm-none-eabi-5_2-2015q4/bin/:${HOSTTOOLS_DIR}:"

# Define the alternative toolchain
SECONDARYTC = 'bare-metal'

# Enable the secondary toolchain
INHERIT += 'tc-secondary tc-blacklist'
```

## sources/linux/Documentation/devicetree/bindings/arm/st,sta-suspend.txt
```
STMicroelectronics STA1xxx PM suspend platform driver

Required properties:
- compatible: "st,sta-suspend"
- mboxes: phandle to sta-mailbox DT node used to send PM suspend message
	  to remote processor.
- st,cpu-resume-addr: address used to store the resumme address where Linux
		      must resume from suspended state.

Examples:

	suspend {
			compatible = "st,sta-suspend";
			mboxes = <&mailbox 15>;
			st,cpu-resume-addr = <0x200001F4>;
		};
```
